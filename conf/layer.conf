## conf/layer.conf
```bitbake
BBPATH .= ":${LAYERDIR}"

BBFILES += "${LAYERDIR}/recipes/*/*.bb \
            ${LAYERDIR}/recipes/*/*.bbappend"

BBFILE_COLLECTIONS += "cicd-test"
BBFILE_PATTERN_cicd-test = "^${LAYERDIR}/"
BBFILE_PRIORITY_cicd-test = "1"

LAYERVERSION_cicd-test = "1"
```
